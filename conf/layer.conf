## conf/layer.conf
```bitbake
# We have a conf and classes directory, add to BBPATH
BBPATH .= ":${LAYERDIR}"

# We have recipes-* directories, add to BBFILES
BBFILES += "${LAYERDIR}/recipes-*/*/*.bb \
            ${LAYERDIR}/recipes-*/*/*.bbappend"

BBFILE_COLLECTIONS += "meta-zirconium"
BBFILE_PATTERN_meta-zirconium = "^${LAYERDIR}/"
BBFILE_PRIORITY_meta-zirconium = "6"

LAYERDEPENDS_meta-zirconium = "core"
LAYERSERIES_COMPAT_meta-zirconium = "dunfell"
```

## conf/machine/colibri-imx7d-m4.conf
```bitbake
#@TYPE: Machine
#@NAME: colibri-imx7d-m4
#@DESCRIPTION: Machine for Zephyr BOARD colibri_imx7d_m4

require conf/machine/include/qemu.inc
require conf/machine/include/tune-cortexm4.inc

ARCH:colibri-imx7d-m4 = "arm"
```
